## drivers/usb/gadget/udc/bdc/Kconfig
```kconfig
config USB_BDC_UDC
	tristate "Broadcom USB3.0 device controller IP driver(BDC)"
	depends on USB_GADGET && HAS_DMA
	default ARCH_BRCMSTB

	help
	BDC is Broadcom's USB3.0 device controller IP. If your SOC has a BDC IP
	then select this driver.

	Say "y" here to link the driver statically, or "m" to build a dynamically
	linked module called "bdc".

if USB_BDC_UDC

comment "Platform Support"
config	USB_BDC_PCI
	tristate "BDC support for PCIe based platforms"
	depends on USB_PCI
	default n 
	help
		Enable support for platforms which have BDC connected through PCIe, such as Lego3 FPGA platform.

config USB_BDC_XGS_IPROC
	tristate "BDC support for broadcom XGS IPROC platforms"
	depends on ARCH_XGS_IPROC && USB_GADGET
	default n

	help
		Enable support for Broadcom XGS IPROC platforms which have BDC, such
		as Helix 5 platform.

		Say "y" to link the driver statically, or "m" to build a dynamically
		linked module called "xgs_iproc_udc" and force all gadget drivers to
		also be dynamically linked.

endif
```
